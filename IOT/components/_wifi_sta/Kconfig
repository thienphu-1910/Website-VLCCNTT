## IOT/components/_wifi_sta/Kconfig
```kconfig
menu "WiFi STA Configuration"

    config WIFI_STA_CONNECT
        bool "Connect using WiFi"
        default n
        help
            Enables The Wifi driver to connect to your local network.
    
    if WIFI_STA_CONNECT
        config WIFI_STA_SSID
            string "WiFi SSID"
            default "myssid"
            help
                Network name (SSID) to connect to.
        
        config WIFI_STA_PASSWORD
            string "WiFi password"
            default "mypassword"
            help
                Network pre-shared key (PSK)
    endif
endmenu
```
